## boards/cei/cookie_nrf_v200/board.yml
```yaml
board:
  name: cookie_nrf_v200
  full_name: Cookie nRF V2.00 sensor node
  vendor: cei
  socs:
    - name: nrf52840
```

## boards/cei/cookie_nrf_v200/cookie_nrf_v200_defconfig
```kconfig
CONFIG_SOC_SERIES_NRF52X=y
CONFIG_SOC_NRF52840_QIAA=y
CONFIG_BOARD_COOKIE_NRF_V200=y

CONFIG_ARM_MPU=y
CONFIG_HW_STACK_PROTECTION=y

CONFIG_GPIO=y
CONFIG_SERIAL=y
CONFIG_CONSOLE=y
CONFIG_UART_CONSOLE=y

CONFIG_BOARD_ENABLE_DCDC=y

CONFIG_CLOCK_CONTROL_NRF_K32SRC_XTAL=y
CONFIG_CLOCK_CONTROL_NRF_K32SRC_20PPM=y

CONFIG_USE_DT_CODE_PARTITION=y
```

## dts/bindings/sensor/invensense,icm20648.yaml
```yaml
description: |
  TDK InvenSense ICM-20648 6-axis IMU (3-axis accelerometer + 3-axis gyroscope).

  This binding is paired with the in-tree driver in libs/cookie_sensors/. The
  upstream Zephyr driver collection ships ICM-426xx and ICM-456xx variants but
  no ICM-20648, so the Cookie firmware carries its own minimal driver.

  Single-shot read pattern is sufficient for the sensor-node duty cycle. FIFO
  burst sampling can be added later without changing the binding.

compatible: "invensense,icm20648"

include: [sensor-device.yaml, i2c-device.yaml]

properties:
  int-gpios:
    type: phandle-array
    description: |
      INT/FSYNC primary interrupt pin. Active-low per datasheet default.
      The driver does not currently use the interrupt; the line is wired
      so that future motion-wake / FIFO-watermark interrupt support is
      drop-in.

  int2-gpios:
    type: phandle-array
    description: |
      INT2 secondary interrupt pin. Active-low. Reserved for the same
      future use as int-gpios.

  accel-fs:
    type: int
    default: 1
    enum: [0, 1, 2, 3]
    description: |
      Accelerometer full-scale range selector applied at init time.
        0 = +/- 2 g    (sensitivity 16384 LSB/g)
        1 = +/- 4 g    (sensitivity  8192 LSB/g)   <-- default
        2 = +/- 8 g    (sensitivity  4096 LSB/g)
        3 = +/- 16 g   (sensitivity  2048 LSB/g)

  gyro-fs:
    type: int
    default: 1
    enum: [0, 1, 2, 3]
    description: |
      Gyroscope full-scale range selector applied at init time.
        0 = +/- 250 dps   (sensitivity 131.0 LSB/dps)
        1 = +/- 500 dps   (sensitivity  65.5 LSB/dps)   <-- default
        2 = +/- 1000 dps  (sensitivity  32.8 LSB/dps)
        3 = +/- 2000 dps  (sensitivity  16.4 LSB/dps)
```

## libs/cookie_power/Kconfig
```kconfig
menuconfig COOKIE_POWER
	bool "Cookie self-current and battery monitoring"
	depends on ADC
	help
	  ADC pipeline for the on-board INA333 instrumentation amplifier
	  (Cookie self-current) and the internal NRF_SAADC_VDD divider
	  (battery voltage). Boards without the matching DT channels compile
	  a no-op fallback so sensor_node binaries stay portable.

if COOKIE_POWER

config COOKIE_POWER_BURST_SAMPLES
	int "Samples per burst (i_avg / i_pk window)"
	default 32
	range 1 256
	help
	  Number of consecutive ADC reads taken to compute one (i_avg, i_pk)
	  pair. With the default 32 samples and ~25 us per acquisition, one
	  burst takes about 1 ms — short enough to stay inside the SED wake
	  window budget.

config COOKIE_POWER_SHUNT_MOHM
	int "Shunt resistor (milliohms)"
	default 100
	help
	  Sense resistor in series with the load. Cookie V2.00 BOM ships
	  100 milliohms by default; replace with the actual value if the
	  shunt is changed at assembly.

config COOKIE_POWER_INA333_GAIN
	int "INA333 gain (1 + 100k/Rg, integer)"
	default 101
	help
	  INA333 amplifier gain set by the Rg resistor. With the default
	  Rg = 1 kohm the gain is 101. Recompute and override here if Rg
	  is replaced.

config COOKIE_POWER_VBAT_MV_PER_LSB_X1000
	int "VBAT scale factor (microvolts per LSB)"
	default 4395
	help
	  ADC LSB to battery millivolts conversion factor, in microvolts per
	  LSB (i.e. multiply ADC raw by this and divide by 1000 to get mV).
	  Default 4395 corresponds to: gain 1/6, ref 0.6 V, internal /5
	  divider, 12-bit resolution
	     -> 0.6 V / (1/6) / 4096 * 5 = 4.395 mV/LSB.
	  Override only if the ADC channel configuration is changed in DT.

config COOKIE_POWER_LOG_LEVEL
	int "Log level for cookie_power"
	depends on LOG
	range 0 4
	default 3

endif
```

## libs/cookie_sensors/Kconfig
```kconfig
menuconfig COOKIE_SENSORS
	bool "Cookie sensor wrappers"
	help
	  Thin wrappers over Zephyr I2C / sensor APIs for the SHTC3 (T+RH) and
	  the ICM-20648 (6-axis IMU). Keeps main loops free of fetch/get
	  boilerplate and centralises power-aware sampling.

if COOKIE_SENSORS

config COOKIE_SENSORS_SHTC3
	bool "SHTC3 temperature/humidity wrapper"
	default y if SENSOR
	help
	  Enables the SHTC3 wrapper. Requires Zephyr SHTC3 driver
	  (CONFIG_SHTCX=y) and a compatible "sensirion,shtc3" or
	  "sensirion,shtcx" node in the devicetree.

config COOKIE_SENSORS_ICM20648
	bool "ICM-20648 6-axis IMU wrapper"
	default y if I2C
	help
	  Enables the ICM-20648 IMU wrapper. The wrapper talks I2C directly
	  (no upstream Zephyr driver exists for this part) and expects an
	  `imu` alias resolving to a node with compatible "invensense,icm20648".
	  Boards without the alias compile a no-op fallback.

config COOKIE_SENSORS_LOG_LEVEL
	int "Log level for cookie_sensors"
	depends on LOG
	range 0 4
	default 3

endif
```

## west.yml
```yaml
manifest:
  version: "0.13"

  remotes:
    - name: nordicsemi
      url-base: https://github.com/nrfconnect

  projects:
    - name: nrf
      remote: nordicsemi
      revision: v3.3.0
      import: true

  self:
    path: cookie-thread-mesh
```
