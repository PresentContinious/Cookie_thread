## CMakeLists.txt
```
cmake_minimum_required(VERSION 3.20.0)

list(APPEND BOARD_ROOT "${CMAKE_CURRENT_SOURCE_DIR}/../..")
list(APPEND DTS_ROOT   "${CMAKE_CURRENT_SOURCE_DIR}/../..")

find_package(Zephyr REQUIRED HINTS $ENV{ZEPHYR_BASE})
project(diag_blinky_ot)

target_sources(app PRIVATE src/main.c)
```

## prj.conf
```kconfig
# Diagnostic: blinky + minimal OpenThread, no sensors / no logs / no USB.
# If this image blinks LEDs the OT SYS_INIT chain itself is fine on Dongle
# and the crash in sensor_node is from one of the optional layers
# (ADC/sensor/SHTCX/SHTC3 driver/COOKIE_*). If LEDs do NOT blink, OT init
# is genuinely broken on this board and we need to dig further (Nordic
# security backend, settings storage, NRF_802154 init order, etc).

CONFIG_GPIO=y

# Console / USB stay off — we don't need them, and they're a confounding
# variable when isolating the OT path.
CONFIG_PRINTK=n
CONFIG_LOG=n
CONFIG_CONSOLE=n
CONFIG_UART_CONSOLE=n
CONFIG_SERIAL=n
CONFIG_USB_DEVICE_STACK=n
CONFIG_USB_DEVICE_STACK_NEXT=n
CONFIG_CDC_ACM_SERIAL_INITIALIZE_AT_BOOT=n

# Force XTAL like Cookie (matches the previous test).
CONFIG_CLOCK_CONTROL_NRF_K32SRC_RC=n
CONFIG_CLOCK_CONTROL_NRF_K32SRC_XTAL=y
CONFIG_CLOCK_CONTROL_NRF_K32SRC_20PPM=y

# --- OpenThread ---------------------------------------------------------
CONFIG_OPENTHREAD=y
CONFIG_NETWORKING=y
CONFIG_NET_L2_OPENTHREAD=y
CONFIG_NET_IPV6=y
CONFIG_NET_UDP=y
CONFIG_NET_SOCKETS=y

# Manual start = don't auto-bring up the protocol; OT instance is still
# created in SYS_INIT but radio doesn't start. Lets us bisect "init"
# vs "protocol start" as the failure point.
CONFIG_OPENTHREAD_MANUAL_START=y

# Stack and entropy.
CONFIG_MAIN_STACK_SIZE=4096
CONFIG_ENTROPY_GENERATOR=y

# Trim mbedtls.
CONFIG_MBEDTLS_SHA1_C=n
```

## src/main.c
```c
/*
 * Same blinker as diag_blinky but with OpenThread linked in (manual
 * start). If LEDs blink, OT SYS_INIT is fine. If LEDs do NOT blink, OT
 * init crashes on Dongle and the symptom is independent of any
 * application-level config.
 *
 * Pattern is intentionally distinct from diag_blinky so we can tell which
 * image is actually flashed: 200 ms both ON, then alternating at 4 Hz
 * (~125 ms each).
 */

#include <zephyr/kernel.h>
#include <zephyr/drivers/gpio.h>

static const struct gpio_dt_spec led_red =
	GPIO_DT_SPEC_GET_OR(DT_ALIAS(led_red), gpios, {0});
static const struct gpio_dt_spec led_green =
	GPIO_DT_SPEC_GET_OR(DT_ALIAS(led_green), gpios, {0});

int main(void)
{
	if (led_red.port) {
		gpio_pin_configure_dt(&led_red,   GPIO_OUTPUT_ACTIVE);
	}
	if (led_green.port) {
		gpio_pin_configure_dt(&led_green, GPIO_OUTPUT_ACTIVE);
	}
	k_sleep(K_MSEC(200));
	if (led_red.port)   gpio_pin_set_dt(&led_red, 0);
	if (led_green.port) gpio_pin_set_dt(&led_green, 0);

	while (1) {
		if (led_red.port)   gpio_pin_set_dt(&led_red, 1);
		if (led_green.port) gpio_pin_set_dt(&led_green, 0);
		k_sleep(K_MSEC(125));
		if (led_red.port)   gpio_pin_set_dt(&led_red, 0);
		if (led_green.port) gpio_pin_set_dt(&led_green, 1);
		k_sleep(K_MSEC(125));
	}
	return 0;
}
```
