## CMakeLists.txt
```
cmake_minimum_required(VERSION 3.20.0)

list(APPEND BOARD_ROOT "${CMAKE_CURRENT_SOURCE_DIR}/../..")
list(APPEND DTS_ROOT   "${CMAKE_CURRENT_SOURCE_DIR}/../..")

find_package(Zephyr REQUIRED HINTS $ENV{ZEPHYR_BASE})
project(diag_init_trace)

target_sources(app PRIVATE src/main.c)
```

## sysbuild.conf
```
SB_CONFIG_BOOTLOADER_MCUBOOT=n

# Disable Partition Manager (deprecated in NCS v3.3, prints warnings, and is
# a candidate culprit for the OT-on-Dongle SYS_INIT crash). Falls back to
# DT-based partitioning, which works fine for our app layout.
SB_CONFIG_PARTITION_MANAGER=n
```

## prj.conf
```kconfig
# SYS_INIT-stage tracer with OpenThread linked in. The visible pulse pattern
# tells us how far Zephyr init progresses before crashing.
#
# Stages:
#   1. PRE_KERNEL_1    -> green flash    200 ms
#   2. PRE_KERNEL_2    -> red flash      200 ms
#   3. POST_KERNEL     -> both flash     200 ms
#   4. APPLICATION     -> alternating fast 200 ms
#   5. main()          -> both solid     1000 ms, then 4 Hz strobe forever
#
# Reading: count visible pulses then map to the deepest stage reached.

CONFIG_GPIO=y
CONFIG_PRINTK=n
CONFIG_LOG=n
CONFIG_CONSOLE=n
CONFIG_UART_CONSOLE=n
CONFIG_SERIAL=n
CONFIG_USB_DEVICE_STACK=n
CONFIG_USB_DEVICE_STACK_NEXT=n
CONFIG_CDC_ACM_SERIAL_INITIALIZE_AT_BOOT=n

CONFIG_CLOCK_CONTROL_NRF_K32SRC_RC=n
CONFIG_CLOCK_CONTROL_NRF_K32SRC_XTAL=y
CONFIG_CLOCK_CONTROL_NRF_K32SRC_20PPM=y

# OpenThread linked in to reproduce the SYS_INIT crash.
CONFIG_OPENTHREAD=y
CONFIG_NETWORKING=y
CONFIG_NET_L2_OPENTHREAD=y
CONFIG_NET_IPV6=y
CONFIG_NET_UDP=y
CONFIG_NET_SOCKETS=y
CONFIG_OPENTHREAD_MANUAL_START=y

CONFIG_MAIN_STACK_SIZE=4096
CONFIG_ENTROPY_GENERATOR=y
CONFIG_MBEDTLS_SHA1_C=n
```

## boards/nrf52840dongle_nrf52840.overlay
```dts
/ {
	aliases {
		led-red   = &led1_red;
		led-green = &led0_green;
	};
};
```

## src/main.c
```c
/*
 * SYS_INIT stage tracer.
 *
 * Drives Dongle LEDs via direct nRF52 GPIO registers (no Zephyr GPIO API
 * required so we can run from PRE_KERNEL_1 onwards). LEDs on the Dongle
 * are ACTIVE_LOW; OUTCLR turns them ON, OUTSET turns them OFF.
 *
 *   green = P0.06   (Dongle LED1, the dedicated green LED)
 *   red   = P0.08   (Dongle LED2 RGB red component)
 */

#include <zephyr/kernel.h>
#include <zephyr/init.h>
#include <zephyr/drivers/gpio.h>
#include <hal/nrf_gpio.h>

#define LED_GREEN_PIN  NRF_GPIO_PIN_MAP(0, 6)
#define LED_RED_PIN    NRF_GPIO_PIN_MAP(0, 8)

static inline void led_init_raw(void)
{
	nrf_gpio_cfg_output(LED_GREEN_PIN);
	nrf_gpio_cfg_output(LED_RED_PIN);
	nrf_gpio_pin_set(LED_GREEN_PIN);  /* OFF (active low) */
	nrf_gpio_pin_set(LED_RED_PIN);
}

static inline void led_green(int on)
{
	if (on) nrf_gpio_pin_clear(LED_GREEN_PIN);
	else    nrf_gpio_pin_set(LED_GREEN_PIN);
}

static inline void led_red(int on)
{
	if (on) nrf_gpio_pin_clear(LED_RED_PIN);
	else    nrf_gpio_pin_set(LED_RED_PIN);
}

/* Busy-wait usable from any init level — ~64 MHz core, ~4 cycles per
 * iteration; 16 M iterations ~= 1 second. */
static void busy_wait_ms(uint32_t ms)
{
	volatile uint32_t i;
	uint32_t total = 16000UL * ms;
	for (i = 0; i < total; i++) {
		__asm__ volatile ("nop");
	}
}

/* ------------------- SYS_INIT stage markers ------------------- */

static int trace_pre_kernel_1(void)
{
	led_init_raw();
	led_green(1);
	busy_wait_ms(200);
	led_green(0);
	return 0;
}
SYS_INIT(trace_pre_kernel_1, PRE_KERNEL_1, 0);

static int trace_pre_kernel_2(void)
{
	led_red(1);
	busy_wait_ms(200);
	led_red(0);
	return 0;
}
SYS_INIT(trace_pre_kernel_2, PRE_KERNEL_2, 99);

static int trace_post_kernel(void)
{
	led_green(1); led_red(1);
	busy_wait_ms(200);
	led_green(0); led_red(0);
	return 0;
}
SYS_INIT(trace_post_kernel, POST_KERNEL, 99);

static int trace_application(void)
{
	for (int i = 0; i < 6; i++) {
		led_green(1); led_red(0);
		busy_wait_ms(33);
		led_green(0); led_red(1);
		busy_wait_ms(33);
	}
	led_green(0); led_red(0);
	return 0;
}
SYS_INIT(trace_application, APPLICATION, 99);

/* ------------------- main ------------------- */

int main(void)
{
	led_green(1); led_red(1);
	k_sleep(K_MSEC(1000));
	led_green(0); led_red(0);
	k_sleep(K_MSEC(300));

	while (1) {
		led_red(1);   k_sleep(K_MSEC(125));
		led_red(0);   led_green(1);
		k_sleep(K_MSEC(125));
		led_green(0);
	}
	return 0;
}
```
