## CMakeLists.txt
```
cmake_minimum_required(VERSION 3.20.0)
find_package(Zephyr REQUIRED HINTS $ENV{ZEPHYR_BASE})
project(diag_sleep)

target_sources(app PRIVATE src/main.c)
```

## prj.conf
```kconfig
# Bare deep-sleep floor diagnostic. No OpenThread, no sensors, no radio: the
# kernel idle thread drops the nRF52840 into System ON deep sleep. Measures the
# board + MCU sleep floor with ideal firmware, to compare against the SED
# 0.51 mA and decide whether that floor comes from the Thread stack or the
# board hardware.

CONFIG_USE_DT_CODE_PARTITION=n

# Silent, lowest-overhead.
CONFIG_CONSOLE=n
CONFIG_UART_CONSOLE=n
CONFIG_SERIAL=n
CONFIG_LOG=n

# Power management: let the idle thread enter System ON deep sleep.
CONFIG_PM=y
CONFIG_PM_DEVICE=y
```

## src/main.c
```c
/*
 * Deep-sleep floor diagnostic.
 *
 * Does nothing but sleep forever. With CONFIG_PM the kernel idle thread puts
 * the nRF52840 into System ON deep sleep. No OpenThread, no sensors, no radio.
 * The current drawn from the supply in this state is the board + MCU sleep
 * floor under ideal firmware, the reference for the SED sleep-current
 * measurement.
 */

#include <zephyr/kernel.h>

int main(void)
{
	while (true) {
		k_sleep(K_SECONDS(3600));
	}
	return 0;
}
```
