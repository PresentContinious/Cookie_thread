## CMakeLists.txt
```
cmake_minimum_required(VERSION 3.20.0)

list(APPEND ZEPHYR_EXTRA_MODULES
	"${CMAKE_CURRENT_SOURCE_DIR}/../../libs/cookie_proto"
	"${CMAKE_CURRENT_SOURCE_DIR}/../../libs/cookie_sensors"
	"${CMAKE_CURRENT_SOURCE_DIR}/../../libs/cookie_power"
)

# Make Zephyr discover boards/cei/cookie_nrf_v200/ in this repo.
list(APPEND BOARD_ROOT "${CMAKE_CURRENT_SOURCE_DIR}/../..")
list(APPEND DTS_ROOT   "${CMAKE_CURRENT_SOURCE_DIR}/../..")

find_package(Zephyr REQUIRED HINTS $ENV{ZEPHYR_BASE})
project(cookie_sensor_node)

target_sources(app PRIVATE
	src/main.c
	src/thread_setup.c
	src/node_loop.c
	src/sed_loop.c
)
```

## Kconfig
```
mainmenu "Cookie sensor node"

choice
	prompt "Node operation profile"
	default NODE_PROFILE_AUTO
	help
	  Selects the runtime shape of the node. AUTO is the headline
	  self-organising-mesh image (FTD, role elected by Thread).
	  SED is the sleepy-end-device variant for low-power measurement.

config NODE_PROFILE_AUTO
	bool "AUTO — FTD, role elected by Thread"

config NODE_PROFILE_SED
	bool "SED — sleepy end device, periodic wake"

endchoice

config NODE_REPORT_INTERVAL_SEC
	int "Sensor reporting cadence (seconds)"
	default 5  if NODE_PROFILE_AUTO
	default 30 if NODE_PROFILE_SED

config NODE_MEAS_LED
	bool "Phase markers on the LED pads (oscilloscope timing campaign)"
	default n
	help
	  Drives the two LED pads as phase markers for the cross-OS timing
	  measurement (same semantics in the RIOT and Contiki-NG ports):

	    red   (P1.10)  HIGH at wake, LOW right after the transmit call
	                   returns. Pulse width = the OS latency from hardware
	                   wake to the frame handed off for transmission, the
	                   scheduler-overhead figure of the Chapter 6 campaign.
	                   Its rising edge is the scope trigger.
	    green (P1.15)  HIGH while the sensors are being read. Width = the
	                   sensor window; TP3 during this window = sensor cost.

	  Also blinks the green LED five times at boot ("image is alive").
	  The markers sink a known, constant LED current while high (red
	  ~1.1 mA, green ~0.5 mA); subtract it from TP3 amplitudes, or build
	  with this option off for the cleanest pure-current image.

config NODE_PAYLOAD_PAD_BYTES
	int "Frame padding for the packet-size sweep (bytes)"
	default 0
	range 0 512
	help
	  Appends a "pad" field of this many bytes to every reported frame so
	  the CoAP payload grows and 6LoWPAN fragments it into several 802.15.4
	  frames. Used for the per-packet-size energy measurement (0 / 64 / 256
	  / 512 in the campaign). Needs COOKIE_PROTO_FRAME_BUF_SIZE raised to
	  hold the padded frame (the measurement overlay does this).

# Thread network credentials live in upstream Kconfig:
#   CONFIG_OPENTHREAD_NETWORK_NAME
#   CONFIG_OPENTHREAD_NETWORKKEY
#   CONFIG_OPENTHREAD_PANID
#   CONFIG_OPENTHREAD_XPANID
#   CONFIG_OPENTHREAD_CHANNEL
# Defaults are set in apps/sensor_node/prj.conf and apply to every node and
# the gateway, so the whole mesh shares one identity at flash time.

source "Kconfig.zephyr"
```

## sysbuild.conf
```
SB_CONFIG_BOOTLOADER_MCUBOOT=n

# Disable Partition Manager: it's deprecated in NCS v3.3 and was the actual
# cause of the SYS_INIT crash that killed every OpenThread image on
# nRF52840 Dongle (and made the OT+USB-CDC clash look like the bug).
# Without PM, Zephyr uses the DT-declared partitions, which is exactly
# what we want anyway since we don't compose multiple images.
SB_CONFIG_PARTITION_MANAGER=n
```

## prj.conf
```kconfig
# Cookie sensor-node firmware: OpenThread + CoAP client + sensor sampling.
#
# Mirrors apps/gateway in NCS-style minimal config. CONFIG_OPENTHREAD=y
# auto-starts the OT stack with the dataset baked in via OPENTHREAD_NETWORK*.
# Profile overlays (overlays/profile_auto.conf, overlays/profile_sed.conf)
# select FTD vs MTD/SED at build time. Board overlays
# (boards/<board>.conf) handle per-board console quirks (Dongle disables
# USB-CDC entirely to avoid the OT-init clash; Cookie uses hardware UART).

# --- Core OpenThread ----------------------------------------------------
CONFIG_OPENTHREAD=y

# Default Thread dataset (one mesh, all nodes match).
CONFIG_OPENTHREAD_NETWORK_NAME="CookieMesh"
CONFIG_OPENTHREAD_NETWORKKEY="00:11:22:33:44:55:66:77:88:99:aa:bb:cc:dd:ee:ff"
CONFIG_OPENTHREAD_PANID=43981
CONFIG_OPENTHREAD_XPANID="de:ad:00:be:ef:00:ca:fe"
CONFIG_OPENTHREAD_CHANNEL=15
CONFIG_OPENTHREAD_DEFAULT_TX_POWER=8

# Settings storage for OT dataset persistence.
CONFIG_PM_PARTITION_SIZE_SETTINGS_STORAGE=0x8000

# --- Zephyr networking (selected explicitly; OPENTHREAD does not pull) -
CONFIG_NETWORKING=y
CONFIG_NET_L2_OPENTHREAD=y
CONFIG_NET_IPV6=y
CONFIG_NET_UDP=y
CONFIG_NET_SOCKETS=y

# OT-native CoAP client (replaces Zephyr CoAP-over-socket; the socket path
# hangs on OT-backed Zephyr because multicast doesn't surface).
CONFIG_OPENTHREAD_COAP=y

# Net buffer pool sized for sparse sensor traffic + multicast discovery.
CONFIG_NET_PKT_RX_COUNT=16
CONFIG_NET_PKT_TX_COUNT=16
CONFIG_NET_BUF_RX_COUNT=80
CONFIG_NET_BUF_TX_COUNT=80
CONFIG_NET_TX_STACK_SIZE=2048
CONFIG_NET_RX_STACK_SIZE=2048
CONFIG_NET_MAX_CONTEXTS=10

# Trim mbedtls (we don't use SHA-1).
CONFIG_MBEDTLS_SHA1_C=n

# --- Stack and runtime --------------------------------------------------
CONFIG_MAIN_STACK_SIZE=4096
CONFIG_SYSTEM_WORKQUEUE_STACK_SIZE=2048
CONFIG_ENTROPY_GENERATOR=y

# --- Cookie libs --------------------------------------------------------
CONFIG_COOKIE_PROTO=y
CONFIG_COOKIE_SENSORS=y
CONFIG_COOKIE_POWER=y

# --- Sensor stack -------------------------------------------------------
# SHTC3 / ICM-20648 / INA333 wrappers all compile a no-op fallback when
# the matching DT alias / channel is absent (Dongle has none of these).
CONFIG_GPIO=y
CONFIG_I2C=y
CONFIG_SENSOR=y
CONFIG_SHTCX=y
CONFIG_ADC=y

# --- Logging (off in SED via overlay; on otherwise) --------------------
CONFIG_LOG=y
CONFIG_LOG_MODE_DEFERRED=y
CONFIG_PRINTK=y
CONFIG_CBPRINTF_FP_SUPPORT=y
CONFIG_FPU=y
```

## bare.conf
```kconfig
# Bare-metal SWD flashing without a bootloader, with NO RTT/console overhead.
# Use for energy measurement builds: the board defconfig pins
# USE_DT_CODE_PARTITION=y (image linked at slot0 = 0xC000, expecting MCUboot
# at 0x0). With no bootloader present the chip reads a blank vector table at
# 0x0 and HardFaults. Link the image at flash base 0x0 instead. Unlike
# rtt.conf this keeps console/logging off so SWD/RTT traffic does not hold
# the core awake or inflate the measured sleep current.
CONFIG_USE_DT_CODE_PARTITION=n
```

## rtt.conf
```kconfig
# Single-board bring-up: route console + logging to SEGGER RTT so telemetry
# is read over the same J-Link/SWD probe, with no UART-to-USB bridge wired.
# Pair with overlays/profile_auto.conf via a semicolon EXTRA_CONF_FILE list.
CONFIG_USE_SEGGER_RTT=y
CONFIG_CONSOLE=y
CONFIG_RTT_CONSOLE=y
CONFIG_UART_CONSOLE=n
CONFIG_LOG_BACKEND_RTT=y
CONFIG_LOG_BACKEND_UART=n
CONFIG_SEGGER_RTT_BUFFER_SIZE_UP=4096

# Bare-metal SWD flashing without a bootloader: the board defconfig pins
# USE_DT_CODE_PARTITION=y (image linked at slot0 = 0xC000, expecting MCUboot
# at 0x0). With no bootloader present the chip reads a blank vector table at
# 0x0 and HardFaults. Link the image at flash base 0x0 instead.
CONFIG_USE_DT_CODE_PARTITION=n

# Bring-up diagnostics: full DEBUG from the sensor wrappers so the ICM-20648
# probe result and any per-read I2C failure are visible over RTT.
CONFIG_COOKIE_SENSORS_LOG_LEVEL=4
```

## boards/cookie_nrf_v200.conf
```kconfig
CONFIG_I2C=y
CONFIG_SENSOR=y
CONFIG_ADC=y
CONFIG_INPUT=y
```

## boards/nrf52840dongle_nrf52840.conf
```kconfig
# Dongle as sensor node, with USB-CDC console enabled for debug visibility.
#
# Now that the OT+USB SYS_INIT crash is solved (it was Partition Manager,
# not the USB stack), we can keep the Dongle's default USB-CDC console
# AND enable logging in deferred mode. The node will appear as a USB
# Serial Device on a fresh COM port and can be read alongside the
# gateway.
#
# LFCLK to the on-board 32.768 kHz crystal (matches Cookie).
CONFIG_INPUT=y

CONFIG_LOG=y
CONFIG_LOG_MODE_DEFERRED=y
CONFIG_PRINTK=y

CONFIG_CLOCK_CONTROL_NRF_K32SRC_RC=n
CONFIG_CLOCK_CONTROL_NRF_K32SRC_XTAL=y
CONFIG_CLOCK_CONTROL_NRF_K32SRC_20PPM=y
```

## boards/nrf52840dongle_nrf52840.overlay
```dts
/ {
	aliases {
		led-red   = &led1_red;
		led-green = &led0_green;
		sw-user   = &button0;
	};
};
```

## src/main.c
```c
/*
 * Sensor-node entry point.
 *
 * OpenThread auto-starts via Zephyr glue (SYS_INIT) with the dataset
 * baked into prj.conf. main() blinks the LED, waits for first attach,
 * brings up CoAP, and dispatches to the AUTO or SED loop.
 */

#include <zephyr/kernel.h>
#include <zephyr/logging/log.h>
#include <zephyr/drivers/gpio.h>

#include <zephyr/net/openthread.h>
#include <openthread/instance.h>
#include <openthread/thread.h>

#include "thread_setup.h"
#include "node_loop.h"
#include "sed_loop.h"

#include <cookie_proto/coap_client.h>

LOG_MODULE_REGISTER(sensor_node, LOG_LEVEL_INF);

static const struct gpio_dt_spec led_red =
	GPIO_DT_SPEC_GET_OR(DT_ALIAS(led_red), gpios, {0});
static const struct gpio_dt_spec led_green =
	GPIO_DT_SPEC_GET_OR(DT_ALIAS(led_green), gpios, {0});

static void bsp_init(void)
{
	if (led_red.port) {
		gpio_pin_configure_dt(&led_red,   GPIO_OUTPUT_INACTIVE);
	}
	if (led_green.port) {
		gpio_pin_configure_dt(&led_green, GPIO_OUTPUT_INACTIVE);
	}
}

int main(void)
{
	LOG_INF("sensor_node: board=%s profile=%s",
		CONFIG_BOARD,
#if defined(CONFIG_NODE_PROFILE_SED)
		"SED"
#else
		"AUTO"
#endif
	);

	bsp_init();

#if defined(CONFIG_NODE_MEAS_LED)
	/* Measurement aid: five green blinks at boot confirm the image is
	 * running, since the SED loop otherwise drives no LED. */
	for (int i = 0; i < 5 && led_green.port; i++) {
		gpio_pin_set_dt(&led_green, 1);
		k_msleep(120);
		gpio_pin_set_dt(&led_green, 0);
		k_msleep(120);
	}
#endif

	/* Persistent OT state is kept across reboots so the node remembers the
	 * mesh and rejoins quickly, which is what makes partition merge and
	 * self-healing work as described in the Thread spec. A one-time clean
	 * wipe is available behind CONFIG_COOKIE_FACTORY_RESET_ON_BOOT for
	 * clearing stale datasets from earlier experiments. */
#if defined(CONFIG_COOKIE_FACTORY_RESET_ON_BOOT)
	{
		otInstance *inst_for_reset = openthread_get_default_instance();
		if (inst_for_reset) {
			otThreadSetEnabled(inst_for_reset, false);
			otIp6SetEnabled(inst_for_reset, false);
			(void)otInstanceErasePersistentInfo(inst_for_reset);
			LOG_INF("OT factory-reset on boot");
		}
	}
#endif

	/* MANUAL_START defaults to y in this NCS configuration, so we run
	 * OT explicitly. The Kconfig dataset has already been loaded by
	 * openthread_init() in SYS_INIT; openthread_run() brings the
	 * interface up and starts the protocol. */
	int orc = openthread_run();
	if (orc) {
		LOG_ERR("openthread_run: %d", orc);
		return -1;
	}

	/* Wait for first attach. Up to 60 s. If we time out we still
	 * proceed — first CoAP push will trigger discovery once attachment
	 * finally happens. */
	(void)cookie_thread_wait_attached(K_SECONDS(60));

	if (cookie_coap_init() != 0) {
		LOG_ERR("CoAP init failed");
		return -1;
	}

#if defined(CONFIG_NODE_PROFILE_SED)
	return cookie_sed_loop_run();
#else
	return cookie_node_loop_start();
#endif
}
```

## src/node_loop.c
```c
/*
 * AUTO-profile main loop.
 *
 * k_timer fires every CONFIG_NODE_REPORT_INTERVAL_SEC, submits work,
 * the work handler samples sensors and pushes a CoAP frame. main()
 * returns to the Zephyr idle thread; scheduler keeps OT + timer + work
 * alive.
 *
 * Sensor readings are best-effort: a missing sensor (Dongle-only build,
 * unwired ICM, broken SAADC channel) leaves the corresponding optional
 * fields cleared and the frame still goes out with whatever is available.
 *
 * LED feedback (visible diagnostic when no console is attached):
 *   - red blinks ~50 ms at the start of each cycle  -> "loop is firing"
 *   - green steady ON while attached to the mesh    -> "Thread role >= CHILD"
 */

#include "node_loop.h"
#include "thread_setup.h"

#include <cookie_proto/coap_client.h>
#include <cookie_proto/frame.h>
#include <cookie_sensors/shtc3.h>
#include <cookie_sensors/icm20648.h>
#include <cookie_power/power.h>

#include <zephyr/kernel.h>
#include <zephyr/logging/log.h>
#include <zephyr/drivers/gpio.h>
#include <zephyr/net/openthread.h>
#include <openthread/instance.h>
#include <openthread/thread.h>

#include <string.h>

LOG_MODULE_REGISTER(node_loop, LOG_LEVEL_INF);

static const struct gpio_dt_spec led_red_lp =
	GPIO_DT_SPEC_GET_OR(DT_ALIAS(led_red), gpios, {0});
static const struct gpio_dt_spec led_grn_lp =
	GPIO_DT_SPEC_GET_OR(DT_ALIAS(led_green), gpios, {0});

static struct k_timer report_timer;
static struct k_work  report_work;

static void blink_red_n(int n)
{
	if (!led_red_lp.port) {
		return;
	}
	for (int i = 0; i < n; i++) {
		gpio_pin_set_dt(&led_red_lp, 1);
		k_sleep(K_MSEC(80));
		gpio_pin_set_dt(&led_red_lp, 0);
		k_sleep(K_MSEC(220));
	}
}

/* Returns blink count encoding the current OT state:
 *   1 = otInstance NULL (broken init)
 *   2 = DISABLED (Thread protocol never started)
 *   3 = DETACHED (Thread started, no partition found)
 *   4 = CHILD
 *   5 = ROUTER
 *   6 = LEADER
 * User counts the red blinks per cycle to know the role.
 */
static int role_blink_count(void)
{
	otInstance *inst = openthread_get_default_instance();
	if (!inst) {
		return 1;
	}
	switch (otThreadGetDeviceRole(inst)) {
	case OT_DEVICE_ROLE_DISABLED: return 2;
	case OT_DEVICE_ROLE_DETACHED: return 3;
	case OT_DEVICE_ROLE_CHILD:    return 4;
	case OT_DEVICE_ROLE_ROUTER:   return 5;
	case OT_DEVICE_ROLE_LEADER:   return 6;
	default:                      return 1;
	}
}

static void set_attached_led(bool attached)
{
	if (led_grn_lp.port) {
		gpio_pin_set_dt(&led_grn_lp, attached ? 1 : 0);
	}
}

static void fill_environmental(struct sensor_frame *f)
{
	if (cookie_shtc3_present()) {
		float t, h;
		if (cookie_shtc3_read(&t, &h) == 0) {
			f->has_temp  = true;
			f->temp_c    = t;
			f->has_humid = true;
			f->humid_pct = h;
		}
	}
}

static void fill_inertial(struct sensor_frame *f)
{
	if (cookie_icm20648_present()) {
		float a[3], g[3];
		if (cookie_icm20648_read(a, g) == 0) {
			f->has_accel = true;
			memcpy(f->accel_g, a, sizeof(a));
			f->has_gyro = true;
			memcpy(f->gyro_dps, g, sizeof(g));
		}
	}
}

static void fill_power(struct sensor_frame *f)
{
	if (cookie_power_present()) {
		struct cookie_power_sample s;
		if (cookie_power_sample_burst(&s) == 0) {
			f->has_i_avg  = true;
			f->i_avg_ma   = s.i_avg_ma;
			f->has_i_pk   = true;
			f->i_pk_ma    = s.i_pk_ma;
			f->has_vbat   = true;
			f->vbat_mv    = s.vbat_mv;
		}
	}
}

static void report_work_handler(struct k_work *w)
{
	ARG_UNUSED(w);

	LOG_INF("work_handler fired, uptime=%u ms", k_uptime_get_32());

	int blinks = role_blink_count();

#if defined(CONFIG_NODE_MEAS_LED)
	/* Phase markers own the LED pads during the timing campaign (same
	 * semantics as the SED loop and the RIOT/Contiki-NG ports): red = cycle
	 * start to transmit handed off, green = sensor window. The role-blink
	 * and attached-LED diagnostics are suppressed so they do not pollute
	 * the marker edges. */
	if (led_red_lp.port) {
		gpio_pin_set_dt(&led_red_lp, 1);
	}
#else
	blink_red_n(blinks);
	set_attached_led(blinks >= 4);
#endif

	bool attached = (blinks >= 4);  /* CHILD/ROUTER/LEADER */
	if (!attached) {
		LOG_DBG("not attached (blinks=%d), skipping push", blinks);
#if defined(CONFIG_NODE_MEAS_LED)
		if (led_red_lp.port) {
			gpio_pin_set_dt(&led_red_lp, 0);
		}
#endif
		return;
	}

	struct sensor_frame f = { 0 };
	f.ts_ms     = k_uptime_get_32();
	f.role      = cookie_thread_role_str();
	f.rssi_dbm  = cookie_thread_parent_rssi();
	f.hops      = cookie_thread_hops_to_leader();
	cookie_thread_format_src(f.src);
	f.pad_len   = CONFIG_NODE_PAYLOAD_PAD_BYTES;

#if defined(CONFIG_NODE_MEAS_LED)
	if (led_grn_lp.port) {
		gpio_pin_set_dt(&led_grn_lp, 1);
	}
#endif
	fill_environmental(&f);
	fill_inertial(&f);
	fill_power(&f);
#if defined(CONFIG_NODE_MEAS_LED)
	if (led_grn_lp.port) {
		gpio_pin_set_dt(&led_grn_lp, 0);
	}
#endif

	/* Local telemetry print for single-board bring-up: emit the same JSON
	 * line the gateway would, so one board shows its own readings over the
	 * console (RTT or UART) without a separate gateway present. */
	{
		char json[CONFIG_COOKIE_PROTO_FRAME_BUF_SIZE];
		int jn = cookie_frame_to_json(&f, json, sizeof(json));
		if (jn > 0) {
			printk("%s\n", json);
		}
	}

	int rc = cookie_coap_push_frame(&f);
	if (rc < 0) {
		LOG_DBG("push: %d", rc);
	}

#if defined(CONFIG_NODE_MEAS_LED)
	/* Falling edge: transmit handed off. Red width = cycle latency. */
	if (led_red_lp.port) {
		gpio_pin_set_dt(&led_red_lp, 0);
	}
#endif
}

static void report_timer_cb(struct k_timer *t)
{
	ARG_UNUSED(t);
	int rc = k_work_submit(&report_work);
	/* Print directly from ISR context — LOG would defer too much.
	 * rc < 0 = error, rc == 0 = was already pending, rc > 0 = freshly
	 * queued. Anything other than 1 means the previous work hasn't
	 * completed and we're stacking. */
	printk("[timer fired, k_work_submit=%d]\n", rc);
}

int cookie_node_loop_start(void)
{
	k_work_init(&report_work, report_work_handler);
	k_timer_init(&report_timer, report_timer_cb, NULL);
	k_timer_start(&report_timer,
		      K_SECONDS(CONFIG_NODE_REPORT_INTERVAL_SEC),
		      K_SECONDS(CONFIG_NODE_REPORT_INTERVAL_SEC));
	LOG_INF("AUTO loop running, interval=%ds", CONFIG_NODE_REPORT_INTERVAL_SEC);
	return 0;
}
```

## src/node_loop.h
```c
#ifndef COOKIE_NODE_LOOP_H_
#define COOKIE_NODE_LOOP_H_

/**
 * Start the AUTO-profile main loop: periodic timer fires every
 * CONFIG_NODE_REPORT_INTERVAL_SEC, samples sensors, pushes a frame.
 *
 * Returns immediately; the timer + workqueue handlers keep running on
 * Zephyr's system threads.
 */
int cookie_node_loop_start(void);

#endif /* COOKIE_NODE_LOOP_H_ */
```

## src/sed_loop.c
```c
/*
 * SED-profile main loop.
 *
 * Each cycle: k_sleep (PM kicks in), wake, optionally re-attach with a
 * 10 s budget, sample sensors, build frame, push CoAP, put the IMU back
 * to sleep, quiesce CoAP. The Zephyr PM subsystem maps k_sleep to System
 * ON deep sleep on nRF52840 when no thread is runnable and devices have
 * suspended.
 *
 * The SED frame's t_active_ms field reports the wake-window duration, used
 * by the PC-tool battery projection and by the Chapter 6 measurement.
 */

#include "sed_loop.h"
#include "thread_setup.h"

#include <cookie_proto/coap_client.h>
#include <cookie_proto/frame.h>
#include <cookie_sensors/shtc3.h>
#include <cookie_sensors/icm20648.h>
#include <cookie_power/power.h>

#include <zephyr/kernel.h>
#include <zephyr/logging/log.h>
#include <zephyr/drivers/gpio.h>

#include <string.h>

LOG_MODULE_REGISTER(sed_loop, LOG_LEVEL_INF);

#if defined(CONFIG_NODE_MEAS_LED)
/* Phase markers for the cross-OS timing measurement (same semantics in the
 * RIOT and Contiki-NG ports; enabled by overlays/meas_led.conf):
 *   red   HIGH at wake, LOW right after the transmit call returns
 *         -> width = wake-to-transmit latency, rising edge = scope trigger;
 *   green HIGH while the sensors are read -> the sensor window. */
static const struct gpio_dt_spec mark_tx =
	GPIO_DT_SPEC_GET_OR(DT_ALIAS(led_red), gpios, {0});
static const struct gpio_dt_spec mark_sens =
	GPIO_DT_SPEC_GET_OR(DT_ALIAS(led_green), gpios, {0});

static inline void mark_set(const struct gpio_dt_spec *m, int on)
{
	if (m->port) {
		gpio_pin_set_dt(m, on);
	}
}
#define MARK_TX(on)    mark_set(&mark_tx, (on))
#define MARK_SENS(on)  mark_set(&mark_sens, (on))
#else
#define MARK_TX(on)    do { } while (0)
#define MARK_SENS(on)  do { } while (0)
#endif

int cookie_sed_loop_run(void)
{
#if defined(CONFIG_NODE_MEAS_LED)
	if (mark_tx.port) {
		gpio_pin_configure_dt(&mark_tx, GPIO_OUTPUT_INACTIVE);
	}
	if (mark_sens.port) {
		gpio_pin_configure_dt(&mark_sens, GPIO_OUTPUT_INACTIVE);
	}
#endif

	while (true) {
		k_sleep(K_SECONDS(CONFIG_NODE_REPORT_INTERVAL_SEC));

		uint32_t t_start = k_uptime_get_32();

		/* Rising edge = scope trigger; stays high until the transmit
		 * call returns, so the pulse width is the wake-to-transmit
		 * latency the campaign measures. */
		MARK_TX(1);

		if (cookie_thread_wait_attached(K_SECONDS(10)) != 0) {
			MARK_TX(0);
			cookie_coap_quiesce();
			(void)cookie_icm20648_sleep();
			continue;
		}

		struct sensor_frame f = { 0 };
		f.ts_ms    = t_start;
		f.role     = "SED";
		f.rssi_dbm = cookie_thread_parent_rssi();
		f.hops     = cookie_thread_hops_to_leader();
		cookie_thread_format_src(f.src);
		f.pad_len = CONFIG_NODE_PAYLOAD_PAD_BYTES;

		/* Sensor window: green high across every sensor access. */
		MARK_SENS(1);

		if (cookie_shtc3_present()) {
			float t, h;
			if (cookie_shtc3_read(&t, &h) == 0) {
				f.has_temp  = true;
				f.temp_c    = t;
				f.has_humid = true;
				f.humid_pct = h;
			}
		}

		if (cookie_icm20648_present()) {
			float a[3], g[3];
			if (cookie_icm20648_read(a, g) == 0) {
				f.has_accel = true;
				memcpy(f.accel_g, a, sizeof(a));
				f.has_gyro  = true;
				memcpy(f.gyro_dps, g, sizeof(g));
			}
		}

		if (cookie_power_present()) {
			struct cookie_power_sample s;
			if (cookie_power_sample_burst(&s) == 0) {
				f.has_i_avg  = true;
				f.i_avg_ma   = s.i_avg_ma;
				f.has_i_pk   = true;
				f.i_pk_ma    = s.i_pk_ma;
				f.has_vbat   = true;
				f.vbat_mv    = s.vbat_mv;
			}
		}

		MARK_SENS(0);

		f.has_t_active = true;
		f.t_active_ms  = k_uptime_get_32() - t_start;

		(void)cookie_coap_push_frame(&f);

		/* Falling edge: transmit handed off. Red pulse width = the OS
		 * wake-to-transmit latency. */
		MARK_TX(0);

		uint32_t t_end = k_uptime_get_32();
		LOG_DBG("wake window %u ms", t_end - t_start);

		/* Quiet down the IMU and CoAP machinery before the next deep
		 * sleep. SHTC3 already sleeps automatically after each one-shot
		 * read; SAADC powers down with the kernel idle. */
		(void)cookie_icm20648_sleep();
		cookie_coap_quiesce();
	}
	return 0;
}
```

## src/sed_loop.h
```c
#ifndef COOKIE_SED_LOOP_H_
#define COOKIE_SED_LOOP_H_

/**
 * Run the SED main loop: sleep, wake, sample, push, quiesce, repeat.
 * Never returns under normal operation.
 */
int cookie_sed_loop_run(void);

#endif /* COOKIE_SED_LOOP_H_ */
```

## src/thread_setup.c
```c
/*
 * OpenThread helpers.
 *
 * The OT stack auto-starts in SYS_INIT (no MANUAL_START), with the dataset
 * loaded by Zephyr glue from CONFIG_OPENTHREAD_NETWORK_NAME / NETWORKKEY /
 * PANID / XPANID / CHANNEL. SED-specific link-mode (rxOnWhenIdle=false,
 * poll period) is applied automatically by the glue when
 * CONFIG_OPENTHREAD_MTD_SED=y.
 *
 * This file therefore exposes only read-side helpers — role string, EUI-64
 * source short form, parent RSSI, hop estimate — and a wait-attached
 * convenience used by main() before opening the CoAP socket.
 */

#include "thread_setup.h"

#include <zephyr/kernel.h>
#include <zephyr/net/openthread.h>

#include <openthread/instance.h>
#include <openthread/link.h>
#include <openthread/platform/radio.h>
#include <openthread/thread.h>

#include <stdio.h>

int cookie_thread_wait_attached(k_timeout_t timeout)
{
	otInstance *inst = openthread_get_default_instance();
	int64_t deadline = k_uptime_get() + k_ticks_to_ms_floor64(timeout.ticks);
	while (k_uptime_get() < deadline) {
		if (inst != NULL &&
		    otThreadGetDeviceRole(inst) >= OT_DEVICE_ROLE_CHILD) {
			return 0;
		}
		k_sleep(K_MSEC(200));
	}
	return -ETIMEDOUT;
}

const char *cookie_thread_role_str(void)
{
#if defined(CONFIG_NODE_PROFILE_SED)
	return "SED";
#else
	otInstance *inst = openthread_get_default_instance();
	if (!inst) {
		return "UNKNOWN";
	}
	switch (otThreadGetDeviceRole(inst)) {
	case OT_DEVICE_ROLE_LEADER:   return "LEADER";
	case OT_DEVICE_ROLE_ROUTER:   return "ROUTER";
	case OT_DEVICE_ROLE_CHILD:    return "CHILD";
	case OT_DEVICE_ROLE_DETACHED: return "DETACHED";
	case OT_DEVICE_ROLE_DISABLED: return "DISABLED";
	default:                      return "UNKNOWN";
	}
#endif
}

void cookie_thread_format_src(char src_out[5])
{
	otInstance *inst = openthread_get_default_instance();
	if (!inst) {
		src_out[0] = '\0';
		return;
	}
	/* Use the Thread extended (MAC) address, not the factory EUI-64: this is
	 * the identity a router reports for us in its neighbour table, so the
	 * gateway's topology tree lines up with this src field. */
	const otExtAddress *ext = otLinkGetExtendedAddress(inst);
	snprintf(src_out, 5, "%02x%02x", ext->m8[6], ext->m8[7]);
}

int8_t cookie_thread_parent_rssi(void)
{
	otInstance *inst = openthread_get_default_instance();
	if (!inst) {
		return 0;
	}
	int8_t avg;
	if (otThreadGetParentAverageRssi(inst, &avg) == OT_ERROR_NONE) {
		return avg;
	}
	return 0;
}

uint8_t cookie_thread_hops_to_leader(void)
{
	otInstance *inst = openthread_get_default_instance();
	if (!inst) {
		return 0;
	}
	switch (otThreadGetDeviceRole(inst)) {
	case OT_DEVICE_ROLE_LEADER:
		return 0;
	case OT_DEVICE_ROLE_ROUTER:
		return 1;
	case OT_DEVICE_ROLE_CHILD:
		return 2;
	default:
		return 0;
	}
}
```

## src/thread_setup.h
```c
#ifndef COOKIE_THREAD_SETUP_H_
#define COOKIE_THREAD_SETUP_H_

#include <zephyr/kernel.h>
#include <stdbool.h>

/**
 * Block until the local OpenThread role reaches at least CHILD, or until
 * the timeout expires. OT auto-starts in SYS_INIT, so by the time main()
 * runs the interface is up and attempting to attach.
 *
 * @return 0 if attached, -ETIMEDOUT otherwise.
 */
int cookie_thread_wait_attached(k_timeout_t timeout);

/**
 * Read the runtime Thread role as a string ("LEADER", "ROUTER", "CHILD",
 * "DETACHED", "DISABLED", "SED" for SED-profile builds).
 */
const char *cookie_thread_role_str(void);

/**
 * Fill src[5] with the last four hex chars of the EUI-64 plus null.
 */
void cookie_thread_format_src(char src_out[5]);

/**
 * @return RSSI to parent in dBm, or 0 if there is no parent.
 */
int8_t cookie_thread_parent_rssi(void);

/**
 * @return number of hops to the Leader (coarse estimate).
 */
uint8_t cookie_thread_hops_to_leader(void);

#endif /* COOKIE_THREAD_SETUP_H_ */
```
